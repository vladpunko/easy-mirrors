## docker/meta-easy-mirrors/conf/layer.conf
```bitbake
# -*- coding: utf-8 -*-

# Copyright 2025 (c) Vladislav Punko <iam.vlad.punko@gmail.com>

BBPATH .= ":${LAYERDIR}"

BBFILES += "${LAYERDIR}/recipes/*/*.bbappend \
            ${LAYERDIR}/recipes/*/*.bb"

BBFILE_COLLECTIONS += "meta-easy-mirrors"
BBFILE_PATTERN_meta-easy-mirrors = "^${LAYERDIR}/"
BBFILE_PRIORITY_meta-easy-mirrors = "6"

LAYERDEPENDS_meta-easy-mirrors = "core"
LAYERSERIES_COMPAT_meta-easy-mirrors = "scarthgap"
```

## docker/meta-easy-mirrors/conf/machine/arch-aarch64.conf
```bitbake
# -*- coding: utf-8 -*-

# Copyright 2025 (c) Vladislav Punko <iam.vlad.punko@gmail.com>

#@TYPE: Machine
#@NAME: arm64
#@DESCRIPTION: Machine configuration for arm 64-bit

require ${COREBASE}/meta/conf/machine/include/arm/arch-arm64.inc

# Disable kernel build.
PREFERRED_PROVIDER_virtual/kernel = "linux-dummy"

DEFAULTTUNE = "aarch64"

# Enable arch-specific recipe overrides.
MACHINEOVERRIDES .= ":aarch64"
```

## docker/meta-easy-mirrors/conf/machine/arch-x86-64.conf
```bitbake
# -*- coding: utf-8 -*-

# Copyright 2025 (c) Vladislav Punko <iam.vlad.punko@gmail.com>

#@TYPE: Machine
#@NAME: x86-64
#@DESCRIPTION: Machine configuration for x86-64

require ${COREBASE}/meta/conf/machine/include/x86/arch-x86.inc

# Disable real kernel build.
PREFERRED_PROVIDER_virtual/kernel = "linux-dummy"

DEFAULTTUNE = "x86-64"

# Enable architecture-specific recipe customizations.
MACHINEOVERRIDES .= ":x86-64"
```
